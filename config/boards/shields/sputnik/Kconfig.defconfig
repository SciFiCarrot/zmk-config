## config/boards/shields/sputnik/Kconfig.defconfig
```kconfig
if SHIELD_SPUTNIK_LEFT

config ZMK_KEYBOARD_NAME
    default "sputnik"

config ZMK_SPLIT_BLE_ROLE_CENTRAL
    default y

endif

if SHIELD_SPUTNIK_RIGHT

config ZMK_SPLIT_BLE_ROLE_CENTRAL
    default n

endif

if SHIELD_SPUTNIK_LEFT || SHIELD_SPUTNIK_RIGHT

config ZMK_SPLIT
    default y

endif
```
